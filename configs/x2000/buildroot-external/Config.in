## configs/x2000/buildroot-external/Config.in
```kconfig
source "$BR2_EXTERNAL_FRE3NDER_PATH/package/python-streaming-form-data/Config.in"
```

## configs/x2000/buildroot-external/package/python-streaming-form-data/Config.in
```kconfig
config BR2_PACKAGE_PYTHON_STREAMING_FORM_DATA
	bool "python-streaming-form-data"
	depends on BR2_PACKAGE_PYTHON3
	select BR2_PACKAGE_PYTHON_AIOFILES
	help
	  Streaming parser for multipart/form-data.

	  https://github.com/siddhantgoel/streaming-form-data
```

## configs/x2000/buildroot.defconfig
```kconfig
# Fre3nder X2000 architecture, ABI, internal toolchain, and base system.
BR2_mipsel=y
BR2_mips_xburst2=y
# BR2_MIPS_SOFT_FLOAT is not set
BR2_MIPS_FP32_MODE_XX=y

BR2_TOOLCHAIN_BUILDROOT=y
BR2_TOOLCHAIN_BUILDROOT_GLIBC=y
BR2_KERNEL_HEADERS_6_6=y
BR2_TOOLCHAIN_BUILDROOT_CXX=y

BR2_OPTIMIZE_S=y
BR2_PIC_PIE=y
BR2_SSP_STRONG=y
BR2_RELRO_FULL=y
BR2_FORTIFY_SOURCE_1=y

BR2_ROOTFS_DEVICE_CREATION_DYNAMIC_MDEV=y
# BR2_TARGET_GENERIC_GETTY is not set
BR2_ENABLE_LOCALE_PURGE=y
BR2_ENABLE_LOCALE_WHITELIST="C en_US"
```
